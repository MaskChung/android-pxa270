## scripts/Config.in
```kconfig
#
# For a description of the syntax of this configuration file,
# see scripts/kbuild/config-language.txt.
#

mainmenu "EPS Android Configuration"

menu "Toolchain"
config TOOLCHAIN
	string "Using which toolchain"
	default "arm-2008q3-41-arm-none-linux-gnueabi-i686-pc-linux-gnu.tar.bz2"
endmenu

menu "Linux Kernel"
config KERNEL_SRC
	string "Android 1.0 SDK, Release 1"
	default "linux-2.6.25-android-1.0_r1"
endmenu

menu "BusyBox"
config BUSYBOX_SRC
	string "BusyBox 1.13.2"
	default "busybox-1.13.2"
endmenu

menu "Root File System"
config BASE_ROOTFS
	string "Base Root File System"
	default "tiny_rootfs.tgz"

menuconfig ANDROID
	bool "Enable Android"
	default n

choice
	prompt "Android version"
	depends on ANDROID
	default ANDROID_DEMO
config ANDROID_DEMO
	bool "Android Demonstration"
config MYDROID
	bool "Compile from Android source"
config MYDROID_SRC
	string "Git version"
	depends on MYDROID
	default "cdma-import"

endchoice

config JFFS2
	bool "Using JFFS2 Root File System"
	default n
config YAFFS2
	bool "Using YAFFS2 Root File System"
	default n
endmenu
```

## scripts/bin/mtd/drivers/mtd/defconfig
```kconfig
# $Id: defconfig,v 1.5 2003/06/23 11:57:54 dwmw2 Exp $

CONFIG_MTD := m
CONFIG_MTD_CONCAT := m
CONFIG_MTD_PARTITIONS := m
CONFIG_MTD_REDBOOT_PARTS := m
CONFIG_MTD_AFS_PARTS := m
CONFIG_MTD_CHAR := m
CONFIG_MTD_BLOCK := m
CONFIG_FTL := m
CONFIG_NFTL := m
CONFIG_INFTL := m
CONFIG_MTD_CFI := m
CONFIG_MTD_CFI_AMDSTD := m
CONFIG_MTD_CFI_INTELEXT := m
CONFIG_MTD_CFI_STAA := m
CONFIG_MTD_GEN_PROBE := m
CONFIG_MTD_JEDECPROBE := m
CONFIG_MTD_INTELPROBE := m
CONFIG_MTD_RAM := m
CONFIG_MTD_ROM := m
CONFIG_MTD_ABSENT := m
CONFIG_MTD_DOC2000 := m
CONFIG_MTD_DOC2001 := m
CONFIG_MTD_DOC2001PLUS := m
CONFIG_MTD_DOCPROBE := m
CONFIG_MTD_SLRAM := m
CONFIG_MTD_PMC551 := $(CONFIG_PCI)
CONFIG_MTD_MTDRAM := m
CONFIG_MTD_CFI_FLAGADM := m
CONFIG_MTD_IQ80310 := m
CONFIG_MTD_L440GX := m
CONFIG_MTD_PHYSMAP := m
CONFIG_MTD_PNC2000 := m
CONFIG_MTD_RPXLITE := m
CONFIG_MTD_SC520CDP := m
CONFIG_MTD_NETSC520 := m
CONFIG_MTD_DBOX2 := m
CONFIG_MTD_IMPA7 := m
ifndef SIMPLEMAP
 CONFIG_MTD_COMPLEX_MAPPINGS := y
 CONFIG_MTD_ELAN_104NC := m
 CONFIG_MTD_OCTAGON := m
 CONFIG_MTD_PCMCIA := m
 CONFIG_MTD_SBC_GXX := m
 CONFIG_MTD_VMAX := m
else
 CONFIG_MTD_COMPLEX_MAPPINGS := n
 CONFIG_MTD_ELAN_104NC := n
 CONFIG_MTD_OCTAGON := n
 CONFIG_MTD_PCMCIA := n
 CONFIG_MTD_SBC_GXX := n
 CONFIG_MTD_VMAX := n
endif
CONFIG_MTD_NAND := m
CONFIG_MTD_NAND_ECC := m
CONFIG_MTD_NAND_IDS := m
```

## scripts/bin/mtd/fs/Kconfig
```kconfig
config JFFS_FS
	tristate "Journalling Flash File System (JFFS) support"
	depends on MTD
	help
	  JFFS is the Journaling Flash File System developed by Axis
	  Communications in Sweden, aimed at providing a crash/powerdown-safe
	  file system for disk-less embedded devices. Further information is
	  available at (<http://developer.axis.com/software/jffs/>).

config JFFS_FS_VERBOSE
	int "JFFS debugging verbosity (0 = quiet, 3 = noisy)"
	depends on JFFS_FS
	default "0"
	help
	  Determines the verbosity level of the JFFS debugging messages.

config JFFS_PROC_FS
	bool "JFFS stats available in /proc filesystem"
	depends on JFFS_FS && PROC_FS
	help
	  Enabling this option will cause statistics from mounted JFFS file systems
	  to be made available to the user in the /proc/fs/jffs/ directory.

config JFFS2_FS
	tristate "Journalling Flash File System v2 (JFFS2) support"
	select CRC32
	depends on MTD
	help
	  JFFS2 is the second generation of the Journalling Flash File System
	  for use on diskless embedded devices. It provides improved wear
	  levelling, compression and support for hard links. You cannot use
	  this on normal block devices, only on 'MTD' devices.

	  Further information on the design and implementation of JFFS2 is
	  available at <http://sources.redhat.com/jffs2/>.

config JFFS2_FS_DEBUG
	int "JFFS2 debugging verbosity (0 = quiet, 2 = noisy)"
	depends on JFFS2_FS
	default "0"
	help
	  This controls the amount of debugging messages produced by the JFFS2
	  code. Set it to zero for use in production systems. For evaluation,
	  testing and debugging, it's advisable to set it to one. This will
	  enable a few assertions and will print debugging messages at the
	  KERN_DEBUG loglevel, where they won't normally be visible. Level 2
	  is unlikely to be useful - it enables extra debugging in certain
	  areas which at one point needed debugging, but when the bugs were
	  located and fixed, the detailed messages were relegated to level 2.

	  If reporting bugs, please try to have available a full dump of the
	  messages at debug level 1 while the misbehaviour was occurring.

config JFFS2_FS_WRITEBUFFER
	bool "JFFS2 write-buffering support"
	depends on JFFS2_FS
	default y
	help
	  This enables the write-buffering support in JFFS2.

	  This functionality is required to support JFFS2 on the following
	  types of flash devices:
	    - NAND flash
	    - NOR flash with transparent ECC
	    - DataFlash

config JFFS2_SUMMARY
	bool "JFFS2 summary support (EXPERIMENTAL)"
	depends on JFFS2_FS && EXPERIMENTAL
	default n
	help
	  This feature makes it possible to use summary information
	  for faster filesystem mount.

	  The summary information can be inserted into a filesystem image
	  by the utility 'sumtool'.

	  If unsure, say 'N'.

config JFFS2_COMPRESSION_OPTIONS
	bool "Advanced compression options for JFFS2"
	depends on JFFS2_FS
	default n
	help
	  Enabling this option allows you to explicitly choose which
	  compression modules, if any, are enabled in JFFS2. Removing
	  compressors and mean you cannot read existing file systems,
	  and enabling experimental compressors can mean that you
	  write a file system which cannot be read by a standard kernel.

	  If unsure, you should _definitely_ say 'N'.

config JFFS2_ZLIB
	bool "JFFS2 ZLIB compression support" if JFFS2_COMPRESSION_OPTIONS
	select ZLIB_INFLATE
	select ZLIB_DEFLATE
	depends on JFFS2_FS
	default y
        help
          Zlib is designed to be a free, general-purpose, legally unencumbered,
          lossless data-compression library for use on virtually any computer
          hardware and operating system. See <http://www.gzip.org/zlib/> for
          further information.

          Say 'Y' if unsure.

config JFFS2_RTIME
	bool "JFFS2 RTIME compression support" if JFFS2_COMPRESSION_OPTIONS
	depends on JFFS2_FS
	default y
        help
          Rtime does manage to recompress already-compressed data. Say 'Y' if unsure.

config JFFS2_RUBIN
	bool "JFFS2 RUBIN compression support" if JFFS2_COMPRESSION_OPTIONS
	depends on JFFS2_FS
	default n
        help
          RUBINMIPS and DYNRUBIN compressors. Say 'N' if unsure.

choice
        prompt "JFFS2 default compression mode" if JFFS2_COMPRESSION_OPTIONS
        default JFFS2_CMODE_PRIORITY
        depends on JFFS2_FS
        help
          You can set here the default compression mode of JFFS2 from
          the available compression modes. Don't touch if unsure.

config JFFS2_CMODE_NONE
        bool "no compression"
        help
          Uses no compression.

config JFFS2_CMODE_PRIORITY
        bool "priority"
        help
          Tries the compressors in a predefinied order and chooses the first
          successful one.

config JFFS2_CMODE_SIZE
        bool "size (EXPERIMENTAL)"
        help
          Tries all compressors and chooses the one which has the smallest
          result.

endchoice

config JFFS3_FS
	tristate "Journalling Flash File System v3 (JFFS3) support (EXPERIMENTAL)"
        select CRC32
	depends on MTD
	help
	  JFFS3 is the third generation of the Journalling Flash File System
	  for use on diskless embedded devices. It provides improved wear
	  levelling, compression and support for hard links. You cannot use
	  this on normal block devices, only on 'MTD' devices.

config JFFS3_FS_DEBUG
	int "JFFS3 debugging verbosity (0 = quiet, 2 = noisy)"
	depends on JFFS3_FS
	default "0"
	help
	  This controls the amount of debugging messages produced by the JFFS3
	  code. Set it to zero for use in production systems. For evaluation,
	  testing and debugging, it's advisable to set it to one. This will
	  enable a few assertions and will print debugging messages at the
	  KERN_DEBUG loglevel, where they won't normally be visible. Level 2
	  is unlikely to be useful - it enables extra debugging in certain
	  areas which at one point needed debugging, but when the bugs were
	  located and fixed, the detailed messages were relegated to level 2.

	  If reporting bugs, please try to have available a full dump of the
	  messages at debug level 1 while the misbehaviour was occurring.

config JFFS3_FS_WRITEBUFFER
	bool "JFFS3 write-buffering support"
	depends on JFFS3_FS
	default y
	help
	  This enables the write-buffering support in JFFS3.

	  This functionality is required to support JFFS3 on the following
	  types of flash devices:
	    - NAND flash
	    - NOR flash with transparent ECC
	    - DataFlash

config JFFS3_SUMMARY
        bool "JFFS3 summary support (EXPERIMENTAL)"
        depends on JFFS3_FS
        default n
        help
          This feature makes it possible to use summary information
          for faster filesystem mount - specially on NAND.

          The summary information can be inserted into a filesystem image
          by the utility 'sumtool'.

          If unsure, say 'N'.

config JFFS3_COMPRESSION_OPTIONS
	bool "Advanced compression options for JFFS3"
	default n
	help
	  Enabling this option allows you to explicitly choose which
	  compression modules, if any, are enabled in JFFS3. Removing
	  compressors and mean you cannot read existing file systems,
	  and enabling experimental compressors can mean that you
	  write a file system which cannot be read by a standard kernel.

	  If unsure, you should _definitely_ say 'N'.

config JFFS3_ZLIB
	bool "JFFS3 ZLIB compression support" if JFFS3_COMPRESSION_OPTIONS
	select ZLIB_INFLATE
	select ZLIB_DEFLATE
	depends on JFFS3_FS
	default y
        help
          Zlib is designed to be a free, general-purpose, legally unencumbered,
          lossless data-compression library for use on virtually any computer
          hardware and operating system. See http://www.gzip.org/zlib/ for
          further information.

          Say 'Y' if unsure.

config JFFS3_RTIME
	bool "JFFS3 RTIME compression support" if JFFS3_COMPRESSION_OPTIONS
	depends on JFFS3_FS
	default y
        help
          Rtime does manage to recompress already-compressed data. Say 'Y' if unsure.

config JFFS3_RUBIN
	bool "JFFS3 RUBIN compression support" if JFFS3_COMPRESSION_OPTIONS
	depends on JFFS3_FS
	default n
        help
          RUBINMIPS and DYNRUBIN compressors. Say 'N' if unsure.

choice
        prompt "JFFS3 default compression mode" if JFFS3_COMPRESSION_OPTIONS
        default JFFS3_CMODE_PRIORITY
        depends on JFFS3_FS
        help
          You can set here the default compression mode of JFFS3 from
          the avaiable compression modes. Don't touch if unsure.

config JFFS3_CMODE_NONE
        bool "no compression"
        help
          Uses no compression.

config JFFS3_CMODE_PRIORITY
        bool "priority"
        help
          Tries the compressors in a predefinied order and chooses the first
          successful one.

config JFFS3_CMODE_SIZE
        bool "size"
        help
          Tries all compressors and chooses the one which has the smallest
          result.

endchoice
```

## scripts/bin/mtd/fs/jffs2/defconfig
```kconfig
# $Id: defconfig,v 1.2 2005/02/09 09:23:53 pavlov Exp $

CONFIG_JFFS2_FS=m
ifdef NONAND
CONFIG_JFFS2_FS_WRITEBUFFER=n
else
CONFIG_JFFS2_FS_WRITEBUFFER=y
endif
```
